## kmod/Kconfig
```kconfig
#
# aQuantia device configuration
#

config AQTION
	tristate "aQuantia AQtion(tm) Support"
	depends on PCI
	depends on MACSEC || MACSEC=n
	imply CRC_ITU_T
	imply PTP_1588_CLOCK
	---help---
	  This enables the support for the aQuantia AQtion(tm) Ethernet card.
```
